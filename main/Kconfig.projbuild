## main/Kconfig.projbuild
```kconfig
menu "StudioPieters"

    comment "For more information visit www.studiopieters.nl"

    config ESP_RELAY_GPIO
        int "Relay GPIO"
        default 16 if IDF_TARGET_ESP32
        default 6  if IDF_TARGET_ESP32C3
        range 0 39
        help
            GPIO driving the relay transistor/driver.
            For ESP32: must be output-capable (0..33). Do NOT use GPIO6..11 (flash).

    config ESP_BLUE_LED_GPIO
        int "Blue LED GPIO"
        default 2  if IDF_TARGET_ESP32
        default 20 if IDF_TARGET_ESP32C3
        range 0 39
        help
            GPIO driving blue LED.
            Note: GPIO2 is a boot strap pin; OK on most devkits/onboard LEDs.

    config ESP_RED_LED_GPIO
        int "Red LED GPIO"
        default 19 if IDF_TARGET_ESP32
        default 3  if IDF_TARGET_ESP32C3
        range 0 39
        help
            GPIO driving red LED.

    config ESP_BUTTON_GPIO
        int "Button GPIO"
        default 23 if IDF_TARGET_ESP32
        default 7  if IDF_TARGET_ESP32C3
        range 0 39
        help
            Button input GPIO (active-low if using button_active_low).
            If using GPIO34..39 on ESP32: these pins are input-only and have NO internal pullups.

    config ESP_SETUP_CODE
        string "HomeKit Setup Code"
        default "693-41-208"
        help
            Configure the HomeKit setup code (update your QR code when changing this value).

    config ESP_SETUP_ID
        string "HomeKit Setup ID"
        default "M4T8"
        help
            Configure the HomeKit setup identifier (update your QR code when changing this value).
endmenu


menu "BL0937 Energy Monitor"

    config ESP_BL0937_CF_GPIO
        int "CF GPIO (pulse input)"
        default 34 if IDF_TARGET_ESP32
        default 4  if IDF_TARGET_ESP32C3
        range 0 39
        help
            BL0937 CF output -> ESP32 input (pulse count).

    config ESP_BL0937_CF1_GPIO
        int "CF1 GPIO (pulse input)"
        default 35 if IDF_TARGET_ESP32
        default 5  if IDF_TARGET_ESP32C3
        range 0 39
        help
            BL0937 CF1 output -> ESP32 input (pulse count).

    config ESP_BL0937_SEL_GPIO
        int "SEL GPIO (output)"
        default 25 if IDF_TARGET_ESP32
        default 21 if IDF_TARGET_ESP32C3
        range 0 39
        help
            BL0937 SEL control -> ESP32 output.
            On ESP32: must be output-capable (0..33). Do NOT use GPIO34..39.

    config ESP_BL0937_SAMPLE_PERIOD_MS
        int "Sampling window (ms)"
        default 1000
        range 50 5000
        help
            Duration of each blocking measurement window. Shorter windows update
            faster but reduce accuracy. Works on ESP32, ESP32-S2/S3, ESP32-C2/C3/C5/C6,
            ESP32-H2 and ESP32-P4 as long as the PCNT peripheral is available.

    config ESP_BL0937_PCNT_GLITCH_NS
        int "PCNT glitch filter (ns)"
        default 0
        range 0 1000
        help
            Optional hardware glitch filter applied by the PCNT peripheral. Leave
            at 0 to disable when targeting devices without PCNT glitch filtering
            support.

endmenu
```

## sdkconfig.defaults
```kconfig
#
# StudioPieters
#

# General Optimization
CONFIG_COMPILER_OPTIMIZATION_SIZE=y


# Binary Size Reduction
CONFIG_LOG_DEFAULT_LEVEL_ERROR=y
CONFIG_ESP_CONSOLE_UART_DEFAULT=n

# RAM Usage Minimization
# CONFIG_FREERTOS_IDLE_TASK_STACKSIZE=512
# CONFIG_FREERTOS_ISR_STACKSIZE=1536
CONFIG_HEAP_POISONING_DISABLED=y
CONFIG_HEAP_TRACING_OFF=y

#
# ESP32-WROOM-32D
#
CONFIG_IDF_TARGET_ESP32=y

#
# BL0937
#
CONFIG_BL0937_GPIO_CF=18
CONFIG_BL0937_GPIO_CF1=19
CONFIG_BL0937_GPIO_SEL=21

#
# HomeKit
#
CONFIG_HOMEKIT_MAX_CLIENTS=16
CONFIG_HOMEKIT_SMALL=y
CONFIG_HOMEKIT_DEBUG=y
# end of HomeKit

#
# wolfSSL
#
CONFIG_WOLFSSL_APPLE_HOMEKIT=y
CONFIG_ESP_MAIN_TASK_STACK_SIZE=10500
```
